## meta-yunsilicon/meta-andes2/conf/layer.conf
```bitbake
BBPATH .= ":${LAYERDIR}"
BBFILES += "${LAYERDIR}/recipes-*/*/*.bb \
            ${LAYERDIR}/recipes-*/*/*.bbappend \
            ${LAYERDIR}/recipes-*/*/*/*.bb \
            ${LAYERDIR}/recipes-*/*/*/*.bbappend"
BBFILE_COLLECTIONS += "yunsilicon-andes2"
BBFILE_PATTERN_yunsilicon-andes2 = "^${LAYERDIR}/"
BBFILE_PRIORITY_yunsilicon-andes2 = "8"
LAYERDEPENDS_yunsilicon-andes2 = "core aspeed-layer yunsilicon-common"
LAYERSERIES_COMPAT_yunsilicon-andes2 = "blacksail wrynose"
```

## meta-yunsilicon/meta-common/conf/layer.conf
```bitbake
BBPATH .= ":${LAYERDIR}"
BBFILES += "${LAYERDIR}/recipes-*/*/*.bb \
            ${LAYERDIR}/recipes-*/*/*.bbappend \
            ${LAYERDIR}/recipes-*/*/*/*.bb \
            ${LAYERDIR}/recipes-*/*/*/*.bbappend"
BBFILE_COLLECTIONS += "yunsilicon-common"
BBFILE_PATTERN_yunsilicon-common = "^${LAYERDIR}/"
BBFILE_PRIORITY_yunsilicon-common = "6"
LAYERDEPENDS_yunsilicon-common = "core"
LAYERSERIES_COMPAT_yunsilicon-common = "blacksail wrynose"
```
